/dts-v1/;
/plugin/;

/ {
    compatible = "nvidia,jetson-orin";

    fragment@0 {
        target-path = "/";
        __overlay__ {
            can1: can@0 {
                compatible = "microchip,mcp2515";
                reg = <0>;                     /* CS = spi1_cs0 */
                spi-max-frequency = <10000000>; /* 10 MHz, ejemplo */
                interrupt-parent = <&gpio>;
                interrupts = <371 0>;          /* GPIO PE.02 */
                status = "okay";
            };
        };
    };
};
